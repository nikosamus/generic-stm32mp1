## data/yocto-labs/build/conf/bblayers.conf
```bitbake
# POKY_BBLAYERS_CONF_VERSION is increased each time build/conf/bblayers.conf
# changes incompatibly
POKY_BBLAYERS_CONF_VERSION = "2"

BBPATH = "${TOPDIR}"
BBFILES ?= ""

BBLAYERS ?= " \
  /workspaces/dk2/data/yocto-labs/poky/meta \
  /workspaces/dk2/data/yocto-labs/poky/meta-poky \
  /workspaces/dk2/data/yocto-labs/poky/meta-yocto-bsp \
  /workspaces/dk2/data/yocto-labs/meta-openembedded/meta-oe \
	/workspaces/dk2/data/yocto-labs/meta-openembedded/meta-python \
  /workspaces/dk2/data/yocto-labs/meta-st-stm32mp \
  "
```
